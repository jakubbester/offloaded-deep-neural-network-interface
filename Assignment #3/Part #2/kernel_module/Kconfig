## Assignment #3/Part #2/kernel_module/Kconfig
```kconfig
# SPDX-License-Identifier: GPL-2.0

menuconfig CUSTOM_MODULES
	bool "Rust custom modules"
	depends on RUST
	help
	  You can build sample Rust kernel code here.

	  If unsure, say N.

if CUSTOM_MODULES

config RUST_CAMERA
	tristate "Camera module"
	help
	  This option builds the Rust camera module.

	  To compile this as a module, choose M here:
	  the module will be called rust_print.

	  If unsure, say N.

endif # CUSTOM_MODULE
```
